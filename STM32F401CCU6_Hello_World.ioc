# file: STM32F401CCU6_Hello_World.ioc
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Mcu.Family=STM32F4
Mcu.Name=STM32F401C(B-C)Ux
Mcu.Package=UFQFPN48
NVIC.PriorityGroup=NVIC_PRIORITYGROUP_4
PB13.GPIO_Label=LED
PB13.Signal=GPIO_Output
PH0\ -\ OSC_IN.Mode=HSE-External-Oscillator
PH0\ -\ OSC_IN.Signal=RCC_OSC_IN
PH1\ -\ OSC_OUT.Mode=HSE-External-Oscillator
PH1\ -\ OSC_OUT.Signal=RCC_OSC_OUT
ProjectManager.HeapSize=0x200
ProjectManager.StackSize=0x400
ProjectManager.TargetToolchain=STM32CubeIDE
RCC.48MHZClocksFreq_Value=42000000
RCC.AHBFreq_Value=84000000
RCC.APB1CLKDivider=RCC_HCLK_DIV2
RCC.APB1Freq_Value=42000000
RCC.APB1TimFreq_Value=84000000
RCC.APB2Freq_Value=84000000
RCC.APB2TimFreq_Value=84000000
RCC.CortexFreq_Value=84000000
RCC.EnbaleCSS=true
RCC.HCLKFreq_Value=84000000
RCC.HSE_VALUE=25000000
RCC.HSI_VALUE=16000000
RCC.LSE_VALUE=32768
RCC.PLLM=25
RCC.PLLN=168
RCC.PLLSourceVirtual=RCC_PLLSOURCE_HSE
RCC.SYSCLKFreq_VALUE=84000000
RCC.SYSCLKSource=RCC_SYSCLKSOURCE_PLLCLK
RCC.VCOOutputFreq_Value=168000000
board=custom

// file: Core/src/main.c
/* USER CODE BEGIN Header */
/**
 ******************************************************************************
 * @file           : main.c
 * @brief          : Main program body
 ******************************************************************************
 * @attention
 *
 * Copyright (c) 2023 STMicroelectronics.
 * All rights reserved.
 *
 * This software is licensed under terms that can be found in the LICENSE file
 * in the root directory of this software component.
 * If no LICENSE file comes with this software, it is provided AS-IS.
 *
 ******************************************************************************
 */
/* USER CODE END Header */
#include "main.h"
#include "gpio.h"
#include <stm32f4xx_ll_crc.h>
#include <stm32f4xx_ll_spi.h>

/* USER CODE BEGIN Includes */
typedef struct program_info
{
    uint32_t crc;
    uint32_t data;
    uint32_t size;
} program_info_t;
__attribute__((section(".info_section"))) volatile const program_info_t crc = {.crc = 0xABCDEF,
                                                                               .data = 0x55,
                                                                               .size = 0xFFFFFFFF};
/* USER CODE END Includes */

/* USER CODE BEGIN PV */
volatile uint32_t systick = 0;
/* USER CODE END PV */

void SystemClock_Config(void);
void System_Delay_ms(uint32_t ms);
void Configure_SPI(void);
void SPI_Tx8(uint8_t *data, uint8_t n);
void SPI_Rx8(uint8_t *data, uint8_t n);

int main(void)
{

    /* MCU Configuration--------------------------------------------------------*/

    /* Reset of all peripherals, Initializes the Flash interface and the Systick. */
    LL_APB2_GRP1_EnableClock(LL_APB2_GRP1_PERIPH_SYSCFG);
    LL_APB1_GRP1_EnableClock(LL_APB1_GRP1_PERIPH_PWR);
    LL_APB1_GRP1_EnableClock(LL_AHB1_GRP1_PERIPH_CRC);

    /* System interrupt init*/
    NVIC_SetPriorityGrouping(NVIC_PRIORITYGROUP_4);

    /* SysTick_IRQn interrupt configuration */
    NVIC_SetPriority(SysTick_IRQn, NVIC_EncodePriority(NVIC_GetPriorityGrouping(), 15, 0));

    /* Configure the system clock */
    SystemClock_Config();
    LL_SYSTICK_EnableIT();

    /* Initialize all configured peripherals */
    MX_GPIO_Init();
    /* USER CODE BEGIN 2 */
    LL_GPIO_SetOutputPin(LED_GPIO_Port, LED_Pin);
    // LL_GPIO_ResetOutputPin(LED_GPIO_Port, LED_Pin);
    Configure_SPI();
    /* USER CODE END 2 */

    System_Delay_ms(100);
    LL_GPIO_ResetOutputPin(GPIOA, LL_GPIO_PIN_4);

    LL_SPI_TransmitData8(SPI1, 0x00);
    while (!LL_SPI_IsActiveFlag_TXE(SPI1))
    {
    }
    LL_SPI_TransmitData8(SPI1, 0x40);
    while (!LL_SPI_IsActiveFlag_TXE(SPI1))
    {
    }
    LL_GPIO_SetOutputPin(GPIOA, LL_GPIO_PIN_4);

    System_Delay_ms(100);

    LL_GPIO_ResetOutputPin(GPIOA, LL_GPIO_PIN_4);

    LL_SPI_TransmitData8(SPI1, 0x40);
    while (!LL_SPI_IsActiveFlag_TXE(SPI1))
    {
    }
    uint8_t rx = LL_SPI_ReceiveData8(SPI1);
    while (!LL_SPI_IsActiveFlag_RXNE(SPI1))
    {
    }
    LL_GPIO_SetOutputPin(GPIOA, LL_GPIO_PIN_4);

    if (rx != 0)
    {
        LL_GPIO_TogglePin(LED_GPIO_Port, LED_Pin);
    }

    /* Infinite loop */
    while (1)
    {
        if (crc.crc == 0)
        {
            break;
        }

        System_Delay_ms(500);
        LL_GPIO_TogglePin(LED_GPIO_Port, LED_Pin);
    }
}

void SystemClock_Config(void)
{
    LL_FLASH_SetLatency(LL_FLASH_LATENCY_2);
    while (LL_FLASH_GetLatency() != LL_FLASH_LATENCY_2)
    {
    }
    LL_PWR_SetRegulVoltageScaling(LL_PWR_REGU_VOLTAGE_SCALE2);
    LL_RCC_HSE_Enable();

    /* Wait till HSE is ready */
    while (LL_RCC_HSE_IsReady() != 1)
    {
    }
    LL_RCC_HSE_EnableCSS();
    LL_RCC_PLL_ConfigDomain_SYS(LL_RCC_PLLSOURCE_HSE, LL_RCC_PLLM_DIV_25, 168, LL_RCC_PLLP_DIV_2);
    LL_RCC_PLL_Enable();

    /* Wait till PLL is ready */
    while (LL_RCC_PLL_IsReady() != 1)
    {
    }
    while (LL_PWR_IsActiveFlag_VOS() == 0)
    {
    }
    LL_RCC_SetAHBPrescaler(LL_RCC_SYSCLK_DIV_1);
    LL_RCC_SetAPB1Prescaler(LL_RCC_APB1_DIV_2);
    LL_RCC_SetAPB2Prescaler(LL_RCC_APB2_DIV_1);
    LL_RCC_SetSysClkSource(LL_RCC_SYS_CLKSOURCE_PLL);

    /* Wait till System clock is ready */
    while (LL_RCC_GetSysClkSource() != LL_RCC_SYS_CLKSOURCE_STATUS_PLL)
    {
    }
    LL_Init1msTick(84000000);
    LL_SetSystemCoreClock(84000000);
    LL_RCC_SetTIMPrescaler(LL_RCC_TIM_PRESCALER_TWICE);
}

void Error_Handler(void)
{
    __disable_irq();
    while (1)
    {
    }
}

void System_Delay_ms(uint32_t ms)
{
    uint32_t local_systick = systick;
    while (local_systick + ms > systick)
    {
    }
}

void Configure_SPI(void)
{
    /* (1) Enables GPIO clock and configures the SPI1 pins ********************/
    /* Enable the peripheral clock of GPIOA */
    LL_AHB1_GRP1_EnableClock(LL_AHB1_GRP1_PERIPH_GPIOA);

    /* Configure CS Pin */
    LL_GPIO_SetPinMode(GPIOA, LL_GPIO_PIN_4, LL_GPIO_MODE_OUTPUT);
    LL_GPIO_SetPinSpeed(GPIOA, LL_GPIO_PIN_4, LL_GPIO_SPEED_FREQ_HIGH);
    LL_GPIO_SetOutputPin(GPIOA, LL_GPIO_PIN_4);

    /* Configure SCK Pin */
    LL_GPIO_SetPinMode(GPIOA, LL_GPIO_PIN_5, LL_GPIO_MODE_ALTERNATE);
    LL_GPIO_SetAFPin_0_7(GPIOA, LL_GPIO_PIN_5, LL_GPIO_AF_5);
    LL_GPIO_SetPinSpeed(GPIOA, LL_GPIO_PIN_5, LL_GPIO_SPEED_FREQ_HIGH);
    LL_GPIO_SetPinPull(GPIOA, LL_GPIO_PIN_5, LL_GPIO_PULL_DOWN);

    /* Configure MISO Pin */
    LL_GPIO_SetPinMode(GPIOA, LL_GPIO_PIN_6, LL_GPIO_MODE_ALTERNATE);
    LL_GPIO_SetAFPin_0_7(GPIOA, LL_GPIO_PIN_6, LL_GPIO_AF_5);
    LL_GPIO_SetPinSpeed(GPIOA, LL_GPIO_PIN_6, LL_GPIO_SPEED_FREQ_HIGH);
    LL_GPIO_SetPinPull(GPIOA, LL_GPIO_PIN_6, LL_GPIO_PULL_DOWN);

    /* Configure MOSI Pin */
    LL_GPIO_SetPinMode(GPIOB, LL_GPIO_PIN_7, LL_GPIO_MODE_ALTERNATE);
    LL_GPIO_SetAFPin_0_7(GPIOB, LL_GPIO_PIN_7, LL_GPIO_AF_5);
    LL_GPIO_SetPinSpeed(GPIOB, LL_GPIO_PIN_7, LL_GPIO_SPEED_FREQ_HIGH);
    LL_GPIO_SetPinPull(GPIOB, LL_GPIO_PIN_7, LL_GPIO_PULL_DOWN);

    /* (2) Configure NVIC for SPI1 transfer complete/error interrupts **********/
    /* Set priority for SPI1_IRQn */
    NVIC_SetPriority(SPI1_IRQn, 0);
    /* Enable SPI1_IRQn           */
    NVIC_EnableIRQ(SPI1_IRQn);

    /* (3) Configure SPI1 functional parameters ********************************/

    /* Enable the peripheral clock of GPIOB */
    LL_APB2_GRP1_EnableClock(LL_APB2_GRP1_PERIPH_SPI1);

    /* Configure SPI1 communication */
    LL_SPI_SetBaudRatePrescaler(SPI1, LL_SPI_BAUDRATEPRESCALER_DIV128);
    LL_SPI_SetTransferDirection(SPI1, LL_SPI_FULL_DUPLEX);
    LL_SPI_SetClockPhase(SPI1, LL_SPI_PHASE_2EDGE);
    LL_SPI_SetClockPolarity(SPI1, LL_SPI_POLARITY_LOW);
    /* Reset value is LL_SPI_MSB_FIRST */
    // LL_SPI_SetTransferBitOrder(SPI1, LL_SPI_MSB_FIRST);
    LL_SPI_SetDataWidth(SPI1, LL_SPI_DATAWIDTH_8BIT);
    LL_SPI_SetNSSMode(SPI1, LL_SPI_NSS_SOFT);
    LL_SPI_SetMode(SPI1, LL_SPI_MODE_MASTER);

    /* Configure SPI1 transfer interrupts */
    /* Enable RXNE  Interrupt             */
    // LL_SPI_EnableIT_RXNE(SPI1);
    // /* Enable TXE   Interrupt             */
    // LL_SPI_EnableIT_TXE(SPI1);
    // /* Enable Error Interrupt             */
    // LL_SPI_EnableIT_ERR(SPI1);
    /* Enable SPI1 */
    LL_SPI_Enable(SPI1);
}
void SPI_Tx8(uint8_t *data, uint8_t n)
{
    uint8_t i = 0;

    LL_GPIO_ResetOutputPin(GPIOA, LL_GPIO_PIN_4);
    while (i < n)
    {
        LL_SPI_TransmitData8(SPI1, *(data + i));
        while (!LL_SPI_IsActiveFlag_TXE(SPI1))
        {
        }
        i++;
    }
    LL_GPIO_SetOutputPin(GPIOA, LL_GPIO_PIN_4);
}

void SPI_Rx8(uint8_t *data, uint8_t n)
{
    uint8_t i = 0;

    LL_GPIO_ResetOutputPin(GPIOA, LL_GPIO_PIN_4);
    while (i < n)
    {
        *(data + i) = LL_SPI_ReceiveData8(SPI1);
        while (!LL_SPI_IsActiveFlag_RXNE(SPI1))
        {
        }
        i++;
    }
    LL_GPIO_SetOutputPin(GPIOA, LL_GPIO_PIN_4);
}
